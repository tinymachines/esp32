## esp32c6-hello/sdkconfig.defaults
```kconfig
# Rust + WiFi requires more stack than default
CONFIG_ESP_MAIN_TASK_STACK_SIZE=16384

# Enable logging output over serial
CONFIG_LOG_DEFAULT_LEVEL_INFO=y

# Use 160 MHz CPU clock (max for ESP32-C6)
CONFIG_ESP_DEFAULT_CPU_FREQ_MHZ_160=y
```
